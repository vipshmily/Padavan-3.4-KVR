## trunk/linux-3.4.x/drivers/net/ethernet/raeth/Kconfig
```kconfig
config RAETH
	tristate "Mediatek Ethernet GMAC"
	---help---
	  This driver supports Mediatek gigabit ethernet family of
	  adapters.

	  Note that the answer to this question doesn't directly affect the
	  kernel: saying N will just cause the configurator to skip all
	  the questions about Mediatek Ethernet devices. If you say Y,
	  you will be asked for your specific card in the following questions.

if RAETH

config  GE1_SGMII_FORCE_2500
	bool "SGMII_FORCE_2500 (GigaSW)"
	depends on RAETH
	---help---
	  If you want to use sgmii force 2500.
	  Please enable GE1_SGMII_FORCE_2500.
          Switch must support SGMII interface.
	  This config will impact switch app makefile.

config ETH_SKB_ALLOC_SELECT
	bool "SKB Allocation API Select"

choice
	prompt "SKB Allocation API Selection"
	depends on ETH_SKB_ALLOC_SELECT
	default ETH_PAGE_ALLOC_SKB

config  ETH_SLAB_ALLOC_SKB
	bool "SLAB skb allocation"

config  ETH_PAGE_ALLOC_SKB
	bool "Page skb allocation"

endchoice

config  RAETH_ESW_CONTROL
	bool "Embedded (or MT7530) Switch Control Module (VLAN/Isolation/Status)"
	default y

config  RAETH_ESW_PORT_WAN
	int "ESW WAN Port ID (0..4)"
	depends on RAETH_ESW_CONTROL
	default 4

config  RAETH_ESW_PORT_LAN1
	int "ESW LAN1 Port ID (0..4)"
	depends on RAETH_ESW_CONTROL
	default 0

config  RAETH_ESW_PORT_LAN2
	int "ESW LAN2 Port ID (0..4)"
	depends on RAETH_ESW_CONTROL
	default 1

config  RAETH_ESW_PORT_LAN3
	int "ESW LAN3 Port ID (0..4)"
	depends on RAETH_ESW_CONTROL
	default 2

config  RAETH_ESW_PORT_LAN4
	int "ESW LAN4 Port ID (0..4)"
	depends on RAETH_ESW_CONTROL
	default 3
	
config NET_MEDIATEK_HNAT
	tristate "MediaTek HW NAT support"
	depends on  NF_CONNTRACK && NF_CONNTRACK_IPV4 && IP_NF_NAT
	---help---
	  This driver supports the hardward
	  Network Address Translation in the
	  MediaTek MT2701/MT7622/MT7629/MT7621
	  chipset family

config NET_MEDIATEK_HW_QOS
	bool "Mediatek HW QoS support"
	depends on NET_MEDIATEK_HNAT
	default y
	---help---
	  This driver supports the hardward
	  quality of service (QoS) control
	  for the hardware NAT in the
	  MediaTek chipset family.

endif 	# RAETH
```
